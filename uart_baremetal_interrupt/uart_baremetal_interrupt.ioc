# file: uart_baremetal_interrupt.ioc
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Mcu.Family=STM32F7
Mcu.Name=STM32F746NGHx
Mcu.Package=TFBGA216
NVIC.PriorityGroup=NVIC_PRIORITYGROUP_4
PH0/OSC_IN.Mode=HSE-External-Oscillator
PH0/OSC_IN.Signal=RCC_OSC_IN
PH1/OSC_OUT.Mode=HSE-External-Oscillator
PH1/OSC_OUT.Signal=RCC_OSC_OUT
PH8.Signal=GPIO_Output
ProjectManager.HeapSize=0x200
ProjectManager.StackSize=0x400
ProjectManager.TargetToolchain=STM32CubeIDE
RCC.AHBFreq_Value=216000000
RCC.APB1CLKDivider=RCC_HCLK_DIV4
RCC.APB1Freq_Value=54000000
RCC.APB1TimFreq_Value=108000000
RCC.APB2CLKDivider=RCC_HCLK_DIV2
RCC.APB2Freq_Value=108000000
RCC.APB2TimFreq_Value=216000000
RCC.CortexFreq_Value=216000000
RCC.HCLKFreq_Value=216000000
RCC.HSE_VALUE=25000000
RCC.HSI_VALUE=16000000
RCC.PLL48CLockSelection=RCC_CLK48SOURCE_PLLSAIP
RCC.PLLI2SN=100
RCC.PLLM=25
RCC.PLLN=432
RCC.PLLQ=9
RCC.PLLSAIN=384
RCC.PLLSAIP=RCC_PLLSAIP_DIV8
RCC.PLLSAIR=5
RCC.PLLSAIRDiv=RCC_PLLSAIDIVR_8
RCC.PLLSourceVirtual=RCC_PLLSOURCE_HSE
RCC.SDMMCClockSelection=RCC_SDMMC1CLKSOURCE_CLK48
RCC.SYSCLKFreq_VALUE=216000000
RCC.SYSCLKSource=RCC_SYSCLKSOURCE_PLLCLK
RCC.USBFreq_Value=48000000
RCC.VCOOutputFreq_Value=432000000
board=STM32F746G-DISCO

// file: Core/Src/main.c
/* USER CODE BEGIN Header */
/**
  ******************************************************************************
  * @file           : main.c
  * @brief          : Main program body
  ******************************************************************************
  * @attention
  *
  * Copyright (c) 2025 STMicroelectronics.
  * All rights reserved.
  *
  * This software is licensed under terms that can be found in the LICENSE file
  * in the root directory of this software component.
  * If no LICENSE file comes with this software, it is provided AS-IS.
  *
  ******************************************************************************
  */
/* USER CODE END Header */
#include "main.h"
/*LED remains on for first 10s, then behaves as expected */
/* USER CODE BEGIN Includes */
#include "stm32f7xx.h"
/* USER CODE END Includes */

/* USER CODE BEGIN PV */
volatile uint8_t blink_flag = 0;
volatile uint8_t blinking=0;
/* USER CODE END PV */

void SystemClock_Config(void);
static void MX_GPIO_Init(void);
/* USER CODE BEGIN PFP */
void uart_init(void);
/* USER CODE END PFP */

int main(void)
{

  /* MCU Configuration--------------------------------------------------------*/

  /* Reset of all peripherals, Initializes the Flash interface and the Systick. */
  HAL_Init();

  /* Configure the system clock */
  SystemClock_Config();

  /* Initialize all configured peripherals */
  MX_GPIO_Init();
  /* USER CODE BEGIN 2 */
  uart_init();

  /* USER CODE END 2 */

  /* Infinite loop */
  while (1)
  {

	  if(blink_flag )
	    {	blinking=1;
	        for (int i = 0; i < 2; i++)
	        {
	            GPIOH->ODR &= ~(1 << 8);
	            HAL_Delay(500);
	            GPIOH->ODR |= (1 << 8);
	            HAL_Delay(500);
	        }
	        blink_flag = 0;

	    }
	  char msg[] = "Hello from USART6\r\n";
	  for (int i = 0; msg[i] != '\0'; i++)
	  {
	     while (!(USART6->ISR & USART_ISR_TXE));  // Wait until TX is empty
	     USART6->TDR = msg[i];                    // Send character
	  }
	  //while (!(USART6->ISR & USART_ISR_TC));       // Transmission complete

	  for (volatile int i = 0; i < 500000; i++);

	  if (USART6->ISR & USART_ISR_RXNE)  // If data received
	  {
	      char c = USART6->RDR;          // Read received data
	      while (!(USART6->ISR & USART_ISR_TXE));
	      USART6->TDR = c;
	  }
	  HAL_Delay(10000);
	  blink_flag=1;

  }
}

void SystemClock_Config(void)
{
  RCC_OscInitTypeDef RCC_OscInitStruct = {0};
  RCC_ClkInitTypeDef RCC_ClkInitStruct = {0};

  /** Configure the main internal regulator output voltage
  */
  __HAL_RCC_PWR_CLK_ENABLE();
  __HAL_PWR_VOLTAGESCALING_CONFIG(PWR_REGULATOR_VOLTAGE_SCALE1);

  /** Initializes the RCC Oscillators according to the specified parameters
  * in the RCC_OscInitTypeDef structure.
  */
  RCC_OscInitStruct.OscillatorType = RCC_OSCILLATORTYPE_HSE;
  RCC_OscInitStruct.HSEState = RCC_HSE_ON;
  RCC_OscInitStruct.PLL.PLLState = RCC_PLL_ON;
  RCC_OscInitStruct.PLL.PLLSource = RCC_PLLSOURCE_HSE;
  RCC_OscInitStruct.PLL.PLLM = 25;
  RCC_OscInitStruct.PLL.PLLN = 432;
  RCC_OscInitStruct.PLL.PLLP = RCC_PLLP_DIV2;
  RCC_OscInitStruct.PLL.PLLQ = 9;
  if (HAL_RCC_OscConfig(&RCC_OscInitStruct) != HAL_OK)
  {
    Error_Handler();
  }

  /** Activate the Over-Drive mode
  */
  if (HAL_PWREx_EnableOverDrive() != HAL_OK)
  {
    Error_Handler();
  }

  /** Initializes the CPU, AHB and APB buses clocks
  */
  RCC_ClkInitStruct.ClockType = RCC_CLOCKTYPE_HCLK|RCC_CLOCKTYPE_SYSCLK
                              |RCC_CLOCKTYPE_PCLK1|RCC_CLOCKTYPE_PCLK2;
  RCC_ClkInitStruct.SYSCLKSource = RCC_SYSCLKSOURCE_PLLCLK;
  RCC_ClkInitStruct.AHBCLKDivider = RCC_SYSCLK_DIV1;
  RCC_ClkInitStruct.APB1CLKDivider = RCC_HCLK_DIV4;
  RCC_ClkInitStruct.APB2CLKDivider = RCC_HCLK_DIV2;

  if (HAL_RCC_ClockConfig(&RCC_ClkInitStruct, FLASH_LATENCY_7) != HAL_OK)
  {
    Error_Handler();
  }
}

static void MX_GPIO_Init(void)
{
  GPIO_InitTypeDef GPIO_InitStruct = {0};

  /* GPIO Ports Clock Enable */
  __HAL_RCC_GPIOH_CLK_ENABLE();

  /*Configure GPIO pin Output Level */
  HAL_GPIO_WritePin(GPIOH, GPIO_PIN_8, GPIO_PIN_RESET);

  /*Configure GPIO pin : PH8 */
  GPIO_InitStruct.Pin = GPIO_PIN_8;
  GPIO_InitStruct.Mode = GPIO_MODE_OUTPUT_PP;
  GPIO_InitStruct.Pull = GPIO_NOPULL;
  GPIO_InitStruct.Speed = GPIO_SPEED_FREQ_LOW;
  HAL_GPIO_Init(GPIOH, &GPIO_InitStruct);

  /* USER CODE BEGIN MX_GPIO_Init_2 */
		RCC->AHB1ENR |= RCC_AHB1ENR_GPIOCEN;
	    RCC->AHB1ENR |= RCC_AHB1ENR_GPIOGEN;

	    // Set PC6 and PG9 to alternate function mode (AF)
	    GPIOC->MODER &= ~(3U << (6 * 2));
	    GPIOC->MODER |= (2U << (6 * 2));  // AF mode

	    GPIOG->MODER &= ~(3U << (9 * 2));
	    GPIOG->MODER |= (2U << (9 * 2));  // AF mode

	    // Set alternate function AF8 (USART6) on PC6 and PG9
	    GPIOC->AFR[0] &= ~(0xF << (6 * 4));
	    GPIOC->AFR[0] |= (8U << (6 * 4));  // PC6 = AF8

	    GPIOG->AFR[1] &= ~(0xF << ((9 - 8) * 4));
	    GPIOG->AFR[1] |= (8U << ((9 - 8) * 4));  // PG9 = AF8

	    // Optional: set output type, speed, pull-up/down
	    GPIOC->OSPEEDR |= (3U << (6 * 2)); // High speed
	    GPIOG->PUPDR &= ~(3U << (9 * 2));  // No pull
  /* USER CODE END MX_GPIO_Init_2 */
}

/* USER CODE BEGIN 4 */
void uart_init(void)
{
		RCC->APB2ENR |= RCC_APB2ENR_USART6EN; // Enable USART6 clock
		USART6->CR1 &= ~USART_CR1_UE; // DISABLE UART BEFORE CONFIGURATION

		USART6->CR1 &= ~USART_CR1_M1 ; //SET FOR 8BIT COMMUNICATION
		USART6-> CR1 &= ~USART_CR1_M0;

		USART6->CR1 |= USART_CR1_OVER8; //OVERSAMPLING BY 16
		USART6-> CR1 &= ~USART_CR1_PCE; //PARITY CONTROL BIT DISABLE
		USART6->CR2 &= ~USART_CR2_STOP; //1 STOP BIT

	    // Baud rate setup (assuming 108 MHz APB2 clock due to PLL settings)
	    // USARTDIV = USARTDIV = Fck / (8 * BaudRate)
		//    					= 108,000,000 / (8 * 115200)
		//						≈ 117.1875
	    // Mantissa = 117
		// Fraction = 0.1875 * 8 = 1.5 ≈ 2
		// BRR = (117 << 4) + 2 = 0x752
	    USART6->BRR = 0x752;
	    USART6->CR1 |= USART_CR1_TE;  // Transmitter enable
	    USART6->CR1 |= USART_CR1_RE;  // Receiver enable

	    USART6->CR1 |= USART_CR1_RXNEIE;  // Enable TC interrupt
	    HAL_NVIC_SetPriority(USART6_IRQn, 0, 0);
	    NVIC_EnableIRQ(USART6_IRQn);

	    USART6->CR1 |= USART_CR1_UE; // ENABLE USART

}

void USART6_IRQHandler(void)
{
    if (USART6->ISR & USART_ISR_RXNE)
    {
        char c = USART6->RDR;       // Read received character
        USART6->TDR = c;            // Echo it back
        blink_flag = 1;             // Trigger LED blink
    }

    if (USART6->ISR & USART_ISR_TC)
    {
        USART6->ICR = USART_ICR_TCCF;  // Clear TC flag properly
    }
}

/* USER CODE END 4 */

void Error_Handler(void)
{
  __disable_irq();
  while (1)
  {
  }
}
