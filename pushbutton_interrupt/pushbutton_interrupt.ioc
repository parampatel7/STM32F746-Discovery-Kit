# file: pushbutton_interrupt.ioc
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Mcu.Family=STM32F7
Mcu.Name=STM32F746NGHx
Mcu.Package=TFBGA216
NVIC.PriorityGroup=NVIC_PRIORITYGROUP_4
ProjectManager.HeapSize=0x200
ProjectManager.StackSize=0x400
ProjectManager.TargetToolchain=STM32CubeIDE
RCC.AHBFreq_Value=200000000
RCC.APB1CLKDivider=RCC_HCLK_DIV4
RCC.APB1Freq_Value=50000000
RCC.APB1TimFreq_Value=100000000
RCC.APB2CLKDivider=RCC_HCLK_DIV2
RCC.APB2Freq_Value=100000000
RCC.APB2TimFreq_Value=200000000
RCC.CortexFreq_Value=200000000
RCC.HCLKFreq_Value=200000000
RCC.HSE_VALUE=25000000
RCC.HSI_VALUE=16000000
RCC.PLL48CLockSelection=RCC_CLK48SOURCE_PLLSAIP
RCC.PLLI2SN=100
RCC.PLLM=25
RCC.PLLN=400
RCC.PLLQ=9
RCC.PLLSAIN=384
RCC.PLLSAIP=RCC_PLLSAIP_DIV8
RCC.PLLSAIR=5
RCC.PLLSAIRDiv=RCC_PLLSAIDIVR_8
RCC.PLLSourceVirtual=RCC_PLLSOURCE_HSE
RCC.SDMMCClockSelection=RCC_SDMMC1CLKSOURCE_CLK48
RCC.SYSCLKFreq_VALUE=200000000
RCC.SYSCLKSource=RCC_SYSCLKSOURCE_PLLCLK
RCC.USBFreq_Value=48000000
RCC.VCOOutputFreq_Value=400000000
board=STM32F746G-DISCO

// file: Core/Src/main.c
/* USER CODE BEGIN Header */
/**
  ******************************************************************************
  * @file           : main.c
  * @brief          : Main program body
  ******************************************************************************
  * @attention
  *
  * Copyright (c) 2025 STMicroelectronics.
  * All rights reserved.
  *
  * This software is licensed under terms that can be found in the LICENSE file
  * in the root directory of this software component.
  * If no LICENSE file comes with this software, it is provided AS-IS.
  *
  ******************************************************************************
  */
/* USER CODE END Header */
#include "main.h"
#include "stm32f7xx.h"

void SystemClock_Config(void);
/* USER CODE BEGIN PFP */
static void MX_GPIO_Init(void);

volatile uint8_t buttonstate = 0;
void EXTI15_10_IRQHandler(void)
{
	if(EXTI->PR & EXTI_PR_PR11){ //CHECKS WHETHER INTERRUPT TRIGGERED, PR REGISTER HAS PENDING INTERRUPT FLAGS FOR ALL EXTI LINES
	EXTI->PR = EXTI_PR_PR11; //CLEAR INTERRUPT FLAG
	buttonstate ^= 1;}
}

/* USER CODE END PFP */

int main(void)
{

  /* MCU Configuration--------------------------------------------------------*/

  /* Reset of all peripherals, Initializes the Flash interface and the Systick. */
  HAL_Init();

  /* Configure the system clock */
  SystemClock_Config();

  /* Initialize all configured peripherals */
MX_GPIO_Init();
  /* Infinite loop */
  while (1)
  {
	  if(buttonstate)
	  {
		  GPIOD->ODR &= ~(1<<5);
	  }
	  else
	  {
		  GPIOD->ODR |= (1<<5);
	  }
  }
}

static void MX_GPIO_Init(void){ //AHB CONNECT CPU TO MEMORY AND PERIPHERALS
	RCC->AHB1ENR |= RCC_AHB1ENR_GPIODEN | RCC_AHB1ENR_GPIOIEN;

	GPIOD->MODER &= ~(3U << 10); //10 BECAUSE WE CONFIGURE THE PD5 PIN, HENCE MODE5
	GPIOD->MODER |= (1U << 10);

	GPIOD->OSPEEDR&= ~(3U << 10);//OUTPUT SPEED REGISTER
	GPIOD->OSPEEDR |= (1U <<10);

	GPIOD-> PUPDR &= ~(3U << 10);

	GPIOI->MODER &= ~(3U << 22); //22 BECAUSE WE CONFIGURE THE PI11 PIN, HENCE MODE5
	GPIOI->PUPDR &= ~(3U <<22);
	GPIOI->PUPDR |= (1U <<22);

	//CONFIGURE EXTI LINE 11 FOR PI11
	/*SYSCFG_EXTICR : These bits are written by software to select the source input for the EXTIx
	external interrupt.
	0000: PA[x] pin
0001: PB[x] pin
0010: PC[x] pin
0011: PD[x] pin
0100: PE[x] pin
0101: PF[x] pin
0110: PG[x] pin
0111: PH[x] pin
1000: PI[x] pin
1001:PJ[x] pin
1010:PK[x] pin
EXTICR[2] manages lines 8–11*/

/*EXTICR[0]	0 to 3
EXTICR[1]	4 to 7
EXTICR[2]	8 to 11 <---- Line 11 here
EXTICR[3]	12 to 15*/
	SYSCFG->EXTICR[2] &= ~(0xF << 12);   // Clear EXTI11 bits, OXF IS GOOD PRACTISE TO CLEAR BITS
    SYSCFG->EXTICR[2] |=  (0x8 << 12);   // Set EXTI11 to Port I, 0X8 IS GOOD PRACTISE TO SET BITS AS ALL BITS NEED TO BE OPERATED TO PREVENT MALFUNCITON

    EXTI->IMR  |= (1 << 11);             // Interrupt request from line 11 is not masked, ALLOWING IT TO GENERATE INTERRUPT, IF NOT DONE NOTHING TRIGGERS
    EXTI->RTSR |= (1 << 11);             // Rising trigger enabled (for Event and Interrupt) for input line

    // Enable NVIC for EXTI15_10
    NVIC_EnableIRQ(EXTI15_10_IRQn);  //Activates the interrupt handler for lines 10–15
    NVIC_SetPriority(EXTI15_10_IRQn, 1); //Sets the priority level. Lower values mean higher priority (0 is the highest).
/*PRIORITY CAN ASLO BE ASSIGNED 0, BUT ITS TYPICALLY RESERVED FOR SYSTEM CRITICAL FUNCTIONS LIKE HARD FAULTS/ TIMER OVERFLOWS THAT MUST PREEMPT EVERYTHING
 * ALSO CAN BLOCK OTHER LESS PRIORITY TASKS LIKE SysTick OR OS SCHEDULING*/
}

void SystemClock_Config(void) {
    // 1. Enable HSI
    RCC->CR |= RCC_CR_HSION;
    while (!(RCC->CR & RCC_CR_HSIRDY));  // Wait until HSI is ready

    // 2. Enable Power interface clock and configure OverDrive
    RCC->APB1ENR |= RCC_APB1ENR_PWREN;

    PWR->CR1 |= PWR_CR1_ODEN;  // Enable OverDrive
    while (!(PWR->CSR1 & PWR_CSR1_ODRDY)); // Wait until OverDrive is ready

    PWR->CR1 |= PWR_CR1_ODSWEN;  // Start OverDrive switch
    while (!(PWR->CSR1 & PWR_CSR1_ODSWRDY)); // Wait until switch is ready

    // 3. Configure Flash latency and cache settings
    FLASH->ACR = FLASH_ACR_LATENCY_7WS |
                 FLASH_ACR_PRFTEN |
                 FLASH_ACR_ARTEN;

    // 4. Configure PLL to use HSI (16 MHz)
    RCC->PLLCFGR = (16 << RCC_PLLCFGR_PLLM_Pos)  | // PLLM = 16
                   (432 << RCC_PLLCFGR_PLLN_Pos) | // PLLN = 432
                   (0 << RCC_PLLCFGR_PLLP_Pos)   | // PLLP = 2
                   (RCC_PLLCFGR_PLLSRC_HSI)      | // PLL source = HSI
                   (9 << RCC_PLLCFGR_PLLQ_Pos);    // PLLQ = 9

    // 5. Enable PLL
    RCC->CR |= RCC_CR_PLLON;
    while (!(RCC->CR & RCC_CR_PLLRDY));  // Wait for PLL to lock

    // 6. Set clock prescalers
    RCC->CFGR = RCC_CFGR_HPRE_DIV1 |    // AHB = SYSCLK / 1
                RCC_CFGR_PPRE1_DIV4 |   // APB1 = AHB / 4
                RCC_CFGR_PPRE2_DIV2;    // APB2 = AHB / 2

    // 7. Switch system clock to PLL
    RCC->CFGR &= ~RCC_CFGR_SW;
    RCC->CFGR |= RCC_CFGR_SW_PLL;
    while ((RCC->CFGR & RCC_CFGR_SWS) != RCC_CFGR_SWS_PLL);  // Wait until PLL is system clock
}

void Error_Handler(void)
{
  __disable_irq();
  while (1)
  {
  }
}
