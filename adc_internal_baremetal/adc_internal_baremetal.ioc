# file: adc_internal_baremetal.ioc
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Mcu.Family=STM32F7
Mcu.Name=STM32F746NGHx
Mcu.Package=TFBGA216
NVIC.PriorityGroup=NVIC_PRIORITYGROUP_4
ProjectManager.HeapSize=0x200
ProjectManager.StackSize=0x400
ProjectManager.TargetToolchain=STM32CubeIDE
RCC.AHBFreq_Value=168000000
RCC.APB1CLKDivider=RCC_HCLK_DIV4
RCC.APB1Freq_Value=42000000
RCC.APB1TimFreq_Value=84000000
RCC.APB2CLKDivider=RCC_HCLK_DIV2
RCC.APB2Freq_Value=84000000
RCC.APB2TimFreq_Value=168000000
RCC.CortexFreq_Value=168000000
RCC.HCLKFreq_Value=168000000
RCC.HSE_VALUE=25000000
RCC.HSI_VALUE=16000000
RCC.LSE_VALUE=32768
RCC.PLLM=10
RCC.PLLN=210
RCC.PLLSourceVirtual=RCC_PLLSOURCE_HSI
RCC.SYSCLKFreq_VALUE=168000000
RCC.SYSCLKSource=RCC_SYSCLKSOURCE_PLLCLK
RCC.USBFreq_Value=168000000
RCC.VCOOutputFreq_Value=336000000
board=STM32F746G-DISCO

// file: Core/Src/main.c
/* USER CODE BEGIN Header */
/**
  ******************************************************************************
  * @file           : main.c
  * @brief          : Main program body
  ******************************************************************************
  * @attention
  *
  * Copyright (c) 2025 STMicroelectronics.
  * All rights reserved.
  *
  * This software is licensed under terms that can be found in the LICENSE file
  * in the root directory of this software component.
  * If no LICENSE file comes with this software, it is provided AS-IS.
  *
  ******************************************************************************
  */
/* USER CODE END Header */
#include "main.h"
#include "stm32f7xx.h"

void SystemClock_Config(void);
void gpio_init(void);
void adc_init(void);
/* USER CODE BEGIN PFP */
uint32_t data;
uint16_t volts;
/* USER CODE END PFP */

int main(void)
{

  /* MCU Configuration--------------------------------------------------------*/

  /* Reset of all peripherals, Initializes the Flash interface and the Systick. */
  HAL_Init();

  /* Configure the system clock */
  SystemClock_Config();
  gpio_init();
  adc_init();

  /* Initialize all configured peripherals */

  /* Infinite loop */
  while (1)
  {
	  ADC1->CR2 |= ADC_CR2_ADON;
	  ADC1->CR2 |= ADC_CR2_SWSTART;//STARTS CONVERSION
	  while(!(ADC1->SR & ADC_SR_EOC));
	  data= ADC1->DR & 0xFFF; //Mask 12 bits
	  volts = (data * 3300) / 4095;    // Convert to millivolts (assuming 3.3V ref)
	  HAL_Delay(500);
  }
}

void adc_init(void)
{
    RCC->APB2ENR |= RCC_APB2ENR_ADC1EN;
    RCC->AHB1ENR |= RCC_AHB1ENR_GPIOAEN;
    GPIOA->MODER |= (3U << (4 * 2)); // Analog mode for PA4

    ADC123_COMMON->CCR |= (1U << 16);  //PCLK DIVIDE BY 4
    ADC123_COMMON-> CCR |= (15U << 8); //DELAY BETWEEN 2 SAMPLING PHRASES
	ADC1->CR1 &= ~(3U << 24); //resolution 12bit
	ADC1->CR1 |= (1U << 8);   //scan mode enabled
	ADC1->SQR3 |= (4U);   //4th channel selected

	//ADC1->CR2 |= ADC_CR2_ALIGN; //LEFT ALIGN DATA, ADC result is placed in bits [15:4] of ADC1->DR for 12bit resolution
	ADC1->CR2 &= ~ADC_CR2_ALIGN;     // Right-align
	ADC1->SMPR2 |= (7U << 12); //480 CHANNEL SAMPLING CYCLES SET
    ADC1->SQR3 = 4U;                    // 1st in regular sequence = channel 4
}

void gpio_init(void)
{
	RCC->AHB1ENR |= RCC_AHB1ENR_GPIOAEN ;
	GPIOA->MODER |= (3U << 8); // PA4 to analog mode
}
void SystemClock_Config(void)
{
	 // 1. Enable HSE
	    RCC->CR |= RCC_CR_HSEON;
	    while (!(RCC->CR & RCC_CR_HSERDY));  // Wait until HSE is ready

	    // 2. Configure Power Regulator
	    /*The STM32's power control system (voltage scaling, overdrive mode, etc.
	     is controlled by the PWR peripheral, but it is disabled by default to save power.
	     So before you can use it, you must enable its clock on the APB1 bus.*/

	    // 3. Enable overdrive mode from power control registers (needed for 216 MHz)
	    /*ODEN This bit enables the OverDrive mode, which is required when running the core at frequencies above 180 MHz
	     The internal voltage regulator must supply more power to the CPU when running at high speeds.
	OverDrive mode boosts the regulator’s output to ensure stable operation at high frequencies.*/
	    RCC->APB1ENR |= RCC_APB1ENR_PWREN;
	    PWR->CR1 |= PWR_CR1_ODEN;  // Overdrive enable
	    while (!(PWR->CSR1 & PWR_CSR1_ODRDY));//wait till overdrive is ready

	    PWR->CR1 |= PWR_CR1_ODSWEN;  // Switch Overdrive,/It starts the transition from regular voltage regulator mode to OverDrive mode.
	    //This is necessary to fully apply the OverDrive settings and allow the system clock to run at up to 216 MHz
	    while (!(PWR->CSR1 & PWR_CSR1_ODSWRDY)); // Wait till OD switch ready

	    // 4. Configure Flash latency(7 wait states for 216 MHz)
	    /*The Flash access control register is used to enable/disable the acceleration features and
	   control the Flash memory access time according to CPU frequency.*/
	    FLASH->ACR = FLASH_ACR_LATENCY_7WS | FLASH_ACR_PRFTEN | FLASH_ACR_ARTEN;//latency for 216MHz, Enable Prefetch, Enable Adaptice Real Time accelerator

	    // 5. Configure PLL
	    RCC->PLLCFGR = (25 << RCC_PLLCFGR_PLLM_Pos)  | // PLLM = 25
	                   (432 << RCC_PLLCFGR_PLLN_Pos) | // PLLN = 432
	                   (0 << RCC_PLLCFGR_PLLP_Pos)   | // PLLP = 2 (00 = /2)
	                   (RCC_PLLCFGR_PLLSRC_HSE)      |
	                   (9 << RCC_PLLCFGR_PLLQ_Pos);    // PLLQ = 9

	    // 5. Enable PLL
	    RCC->CR |= RCC_CR_PLLON;
	    while (!(RCC->CR & RCC_CR_PLLRDY));  // Wait for PLL to lock

	    // 6. Configure clock dividers, Set AHB, APB1, and APB2 prescalers before switching system clock
	    RCC->CFGR = RCC_CFGR_HPRE_DIV1 |    // AHB = SYSCLK / 1
	                RCC_CFGR_PPRE1_DIV4 |   // APB1 = AHB / 4
	                RCC_CFGR_PPRE2_DIV2;    // APB2 = AHB / 2

	    // 7. Switch system clock to PLL
	    RCC->CFGR &= ~RCC_CFGR_SW;
	    RCC->CFGR |= RCC_CFGR_SW_PLL;
	    while ((RCC->CFGR & RCC_CFGR_SWS) != RCC_CFGR_SWS_PLL);  // Wait until PLL is system clock
}

void Error_Handler(void)
{
  __disable_irq();
  while (1)
  {
  }
}
