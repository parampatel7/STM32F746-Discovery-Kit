# file: i2c_bit_banging.ioc
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Mcu.Family=STM32F7
Mcu.Name=STM32F746NGHx
Mcu.Package=TFBGA216
NVIC.PriorityGroup=NVIC_PRIORITYGROUP_4
PH0/OSC_IN.Mode=HSE-External-Oscillator
PH0/OSC_IN.Signal=RCC_OSC_IN
PH1/OSC_OUT.Mode=HSE-External-Oscillator
PH1/OSC_OUT.Signal=RCC_OSC_OUT
ProjectManager.HeapSize=0x200
ProjectManager.StackSize=0x400
ProjectManager.TargetToolchain=STM32CubeIDE
RCC.AHBFreq_Value=216000000
RCC.APB1CLKDivider=RCC_HCLK_DIV4
RCC.APB1Freq_Value=54000000
RCC.APB1TimFreq_Value=108000000
RCC.APB2CLKDivider=RCC_HCLK_DIV2
RCC.APB2Freq_Value=108000000
RCC.APB2TimFreq_Value=216000000
RCC.CortexFreq_Value=216000000
RCC.HCLKFreq_Value=216000000
RCC.HSE_VALUE=25000000
RCC.HSI_VALUE=16000000
RCC.LSE_VALUE=32768
RCC.PLLM=8
RCC.PLLN=216
RCC.PLLSourceVirtual=RCC_PLLSOURCE_HSI
RCC.SYSCLKFreq_VALUE=216000000
RCC.SYSCLKSource=RCC_SYSCLKSOURCE_PLLCLK
RCC.USBFreq_Value=216000000
RCC.VCOOutputFreq_Value=432000000
board=STM32F746G-DISCO

// file: Core/Src/main.c
/* USER CODE BEGIN Header */
/**
  ******************************************************************************
  * @file           : main.c
  * @brief          : Main program body
  ******************************************************************************
  * @attention
  *
  * Copyright (c) 2025 STMicroelectronics.
  * All rights reserved.
  *
  * This software is licensed under terms that can be found in the LICENSE file
  * in the root directory of this software component.
  * If no LICENSE file comes with this software, it is provided AS-IS.
  *
  ******************************************************************************
  */
/* USER CODE END Header */
/*
 * What: Bit banging is a technique where software manually controls the state of GPIO pins to simulate a communication protocol (like I²C, SPI, UART, etc.),
 instead of using dedicated hardware peripherals.
 * Why: No hardware support available – The microcontroller lacks I²C/SPI/UART peripherals.
 If controller has less flash memory to store code, it can be used to avoid unnecessary memory storage by APIs, drivers etc.
 More control needed – You want to implement custom timing or protocols.
 Multiple buses required – You need more I²C interfaces than the hardware provides.
 Hardware bug workaround – The onboard peripheral is buggy or limited.
 Quick prototyping – Easier to implement in test code for basic communication.
 * When: You need high-speed communication (e.g., >400 kHz I²C, high-speed UART/SPI).
 The CPU is already heavily loaded — bit banging is CPU-intensive.
 Power efficiency is a priority — more CPU cycles = more power.
 Timing accuracy is critical (e.g., real-time systems).
 Your application demands robust, reliable communication under load.*/
//led, both ram in same code
#include "main.h"
#include "stm32f7xx.h"
#include <string.h>
#include <stdbool.h>
#define EEPROM_ADDR			0xA6
#define EEPROM_MEM_ADDR		0x00

uint8_t writeData[]= "Param ";
uint8_t readData[sizeof(writeData)] = {0};

#define clk_high	GPIOB->ODR |= (1U << 6)
#define clk_low		GPIOB->ODR &= ~(1U << 6)
#define sda_high	GPIOB->ODR |= (1U << 7)
#define sda_low		GPIOB->ODR &= ~(1U << 7)
#define GPIO_INPUT	GPIOB->MODER &= ~(0x3 << 14)
#define GPIO_OUTPUT	GPIOB->MODER |=  (0x1 << (14))

void SystemClock_Config(void);
static void MX_GPIO_Init(void);
void start(void);
void stop(void);
void write_bit(uint8_t bit);
uint8_t read_bit(void);
bool write_byte(uint8_t byte, bool do_start, bool do_stop);
uint8_t read_byte(bool ack, bool do_stop);
void eeprom_write(uint8_t mem_addr, uint8_t *data, uint8_t len);
void eeprom_read(uint8_t mem_addr, uint8_t *data, uint8_t len);
void DWT_Init(void)
{
    CoreDebug->DEMCR |= CoreDebug_DEMCR_TRCENA_Msk;
    DWT->CTRL |= DWT_CTRL_CYCCNTENA_Msk;
}

void delay_us(uint32_t us)
{
    uint32_t start = DWT->CYCCNT;
    uint32_t ticks = us * (SystemCoreClock / 1000000);
    while ((DWT->CYCCNT - start) < ticks);
}

int main(void)
{

  /* MCU Configuration--------------------------------------------------------*/

  /* Reset of all peripherals, Initializes the Flash interface and the Systick. */
  HAL_Init();
  DWT_Init();

  /* Configure the system clock */
  SystemClock_Config();

  /* Initialize all configured peripherals */
  MX_GPIO_Init();
  /* USER CODE BEGIN 2 */
  // Write to EEPROM
 eeprom_write(EEPROM_MEM_ADDR, writeData, sizeof(writeData));
  HAL_Delay(5); // Wait for EEPROM internal write cycle

  // Read back
  eeprom_read(EEPROM_MEM_ADDR, readData, sizeof(readData));
  /* USER CODE END 2 */

  /* Infinite loop */
  while (1)
  {

		  if(memcmp(writeData, readData, sizeof(writeData))==0)
		  {
			  HAL_GPIO_TogglePin(GPIOH, GPIO_PIN_8 );
			  HAL_Delay(1000);
		  }
}
}
void start()
{	sda_high;
	delay_us(4);
	clk_high;
	delay_us(2);
	sda_high;
	delay_us(1);
	sda_low;
	delay_us(1);
	clk_low;
	delay_us(4);

}
void stop()
{
	sda_low;
	delay_us(4);
	clk_high;
	delay_us(2);
	sda_high;
	delay_us(2);
}
void write_bit(uint8_t bit)
{
	if(bit)
		sda_high;
	else
		sda_low;
	delay_us(4);
	clk_high;
	delay_us(4);
	clk_low;
	delay_us(4);
}
uint8_t read_bit(void)
{
	uint8_t bit;
	GPIO_INPUT;
	sda_high;
	delay_us(2);
	clk_high;
	delay_us(4);
	bit= (GPIOB->IDR >> 7) & 0x01;
	clk_low;
	delay_us(4);
	GPIO_OUTPUT;
	return bit;
}
bool write_byte(uint8_t byte, bool do_start, bool do_stop)
{

	if(do_start){ start();}
		uint8_t i;
		for(i=0; i<8; i++)
		{
			write_bit((byte & 0x80) != 0);
			byte <<=1;
		}
		GPIO_INPUT;
		uint8_t ack= !read_bit();
		GPIO_OUTPUT;
		if(do_stop) stop();
		return ack;

}
uint8_t read_byte(bool ack, bool do_stop)
{
	uint8_t byte = 0;

		for (uint8_t i = 0; i < 8; i++)
		{
			byte <<= 1;
			byte |= read_bit();
		}

		// Send ACK/NACK
		write_bit(!ack);  // ack = 1 → send ACK (pull SDA low), ack = 0 → send NACK

		if (do_stop)
			stop();

		return byte;
}

void eeprom_write(uint8_t mem_addr, uint8_t* data, uint8_t len)
{
    start();
    if((EEPROM_ADDR == 0xA8) || (EEPROM_ADDR == 0xAA) || (EEPROM_ADDR == 0xAC) || (EEPROM_ADDR == 0xAE))
    {
    	HAL_GPIO_WritePin(GPIOG, GPIO_PIN_12, GPIO_PIN_RESET);
    }
    else
    {
    	HAL_GPIO_WritePin(GPIOG, GPIO_PIN_12, GPIO_PIN_SET);
    }
    write_byte(EEPROM_ADDR & ~0x01, false, false); // Write mode
    write_byte(mem_addr, false, false);

    for (uint8_t i = 0; i < len; i++)
        write_byte(data[i], false, false);

    stop();
}

void eeprom_read(uint8_t mem_addr, uint8_t* data, uint8_t len)
{
    // Set EEPROM address to read from
    start();
    if((EEPROM_ADDR == 0xA8) | (EEPROM_ADDR == 0xAA) | (EEPROM_ADDR == 0xAC) | (EEPROM_ADDR == 0xAE))
        {
        	HAL_GPIO_WritePin(GPIOG, GPIO_PIN_12, GPIO_PIN_RESET);
        }
    else
        {
        	HAL_GPIO_WritePin(GPIOG, GPIO_PIN_12, GPIO_PIN_SET);
        }
    write_byte(EEPROM_ADDR & ~0x01, false, false); // Write mode
    write_byte(mem_addr, false, false);

    // Restart and switch to read mode
    start();
    write_byte(EEPROM_ADDR | 0x01, false, false); // Read mode

    for (uint8_t i = 0; i < len; i++)
    {
        bool ack = (i < len - 1); // ACK all but last byte
        data[i] = read_byte(ack, false);
    }

    stop();
}
void SystemClock_Config(void)
{
  RCC_OscInitTypeDef RCC_OscInitStruct = {0};
  RCC_ClkInitTypeDef RCC_ClkInitStruct = {0};

  /** Configure the main internal regulator output voltage
  */
  __HAL_RCC_PWR_CLK_ENABLE();
  __HAL_PWR_VOLTAGESCALING_CONFIG(PWR_REGULATOR_VOLTAGE_SCALE1);

  /** Initializes the RCC Oscillators according to the specified parameters
  * in the RCC_OscInitTypeDef structure.
  */

  RCC_OscInitStruct.OscillatorType = RCC_OSCILLATORTYPE_HSI;
  RCC_OscInitStruct.HSIState = RCC_HSI_ON;
  RCC_OscInitStruct.HSICalibrationValue = RCC_HSICALIBRATION_DEFAULT;
  RCC_OscInitStruct.PLL.PLLState = RCC_PLL_ON;
  RCC_OscInitStruct.PLL.PLLSource = RCC_PLLSOURCE_HSI;
  RCC_OscInitStruct.PLL.PLLM = 8;
  RCC_OscInitStruct.PLL.PLLN = 216;
  RCC_OscInitStruct.PLL.PLLP = RCC_PLLP_DIV2;
  RCC_OscInitStruct.PLL.PLLQ = 2;
  if (HAL_RCC_OscConfig(&RCC_OscInitStruct) != HAL_OK)
  {
    Error_Handler();
  }

  /** Activate the Over-Drive mode
  */
  if (HAL_PWREx_EnableOverDrive() != HAL_OK)
  {
    Error_Handler();
  }

  /** Initializes the CPU, AHB and APB buses clocks
  */
  RCC_ClkInitStruct.ClockType = RCC_CLOCKTYPE_HCLK|RCC_CLOCKTYPE_SYSCLK
                              |RCC_CLOCKTYPE_PCLK1|RCC_CLOCKTYPE_PCLK2;
  RCC_ClkInitStruct.SYSCLKSource = RCC_SYSCLKSOURCE_PLLCLK;
  RCC_ClkInitStruct.AHBCLKDivider = RCC_SYSCLK_DIV1;
  RCC_ClkInitStruct.APB1CLKDivider = RCC_HCLK_DIV4;
  RCC_ClkInitStruct.APB2CLKDivider = RCC_HCLK_DIV2;

  if (HAL_RCC_ClockConfig(&RCC_ClkInitStruct, FLASH_LATENCY_7) != HAL_OK)
  {
    Error_Handler();
  }
}

static void MX_GPIO_Init(void)
{
  /* USER CODE BEGIN MX_GPIO_Init_1 */
	RCC->AHB1ENR |= RCC_AHB1ENR_GPIOHEN;
	RCC->AHB1ENR |= RCC_AHB1ENR_GPIOBEN;
	RCC->AHB1ENR |= RCC_AHB1ENR_GPIOGEN;
    GPIOB->MODER &= ~(0x3 << (6 * 2)); // Clear MODER6
    GPIOB->MODER &= ~(0x3 << (7 * 2)); // Clear MODER7
    GPIOG->MODER &= ~(0x3 << (12 * 2));
    // Set to 01: General purpose output mode
    GPIOB->MODER |= (0x1 << (6 * 2)); // Set MODER6
    GPIOB->MODER |= (0x1 << (7 * 2)); // Set MODER7
    GPIOH->MODER |= (0x1 << (8 * 2)); // Set MODER8
    GPIOG->MODER |= (0x1 << (12 * 2)); // Set MODER8
    // 3. Set output type to push-pull (default)
    GPIOB->OTYPER &= ~((1 << 6) | (1 << 7));
    GPIOH->OTYPER &= ~(1 << 8);
    GPIOG->OTYPER &= ~(1 << 12);
    // 4. Set output speed (optional — here: high speed)
    GPIOB->OSPEEDR |= (0x3 << (6 * 2)); // High speed for PB6
    GPIOB->OSPEEDR |= (0x3 << (7 * 2)); // High speed for PB7
    GPIOH->OSPEEDR |= (0x3 << (8 * 2));
    GPIOG->OSPEEDR |= (0x3 << (12 * 2));
    // 5. Set no pull-up/pull-down
    GPIOB->PUPDR &= ~(0x3 << (6 * 2));
    GPIOB->PUPDR &= ~(0x3 << (7 * 2));
    GPIOH->PUPDR &= ~(0x3 << (8 * 2));
    GPIOG->PUPDR &= ~(0x3 << (12 * 2));
  /* USER CODE END MX_GPIO_Init_1 */

  /* GPIO Ports Clock Enable */
}

void Error_Handler(void)
{
  __disable_irq();
  while (1)
  {
  }
}
